#include "user_lcd.h"
#include "user_tim.h"
#include "user_spi.h"

extern SPI_HandleTypeDef hspi2;

const uint8_t ASCII_1206[][12]={
  {0x00,0x00,0x00,0x00,0x00,0x00,0x00,0x00,0x00,0x00,0x00,0x00},/*" ",0*/
  {0x00,0x00,0x04,0x04,0x04,0x04,0x04,0x00,0x00,0x04,0x00,0x00},/*"!",1*/
  {0x14,0x14,0x0A,0x00,0x00,0x00,0x00,0x00,0x00,0x00,0x00,0x00},/*""",2*/
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  {0x16,0x09,0x00,0x00,0x00,0x00,0x00,0x00,0x00,0x00,0x00,0x00},/*"~",94*/
};

const uint8_t ASCII_1608[][16]={
  {0x00,0x00,0x00,0x00,0x00,0x00,0x00,0x00,0x00,0x00,0x00,0x00,0x00,0x00,0x00,0x00},/*" ",0*/
  {0x00,0x00,0x00,0x08,0x08,0x08,0x08,0x08,0x08,0x08,0x00,0x00,0x18,0x18,0x00,0x00},/*"!",1*/
  {0x00,0x48,0x6C,0x24,0x12,0x00,0x00,0x00,0x00,0x00,0x00,0x00,0x00,0x00,0x00,0x00},/*""",2*/
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  {0x0C,0x32,0xC2,0x00,0x00,0x00,0x00,0x00,0x00,0x00,0x00,0x00,0x00,0x00,0x00,0x00},/*"~",94*/
}; 
const uint8_t ASCII_2412[][48]={
  {0x00,0x00,0x00,0x00,0x00,0x00,0x00,0x00,0x00,0x00,0x00,0x00,0x00,0x00,0x00,0x00,0x00,0x00,0x00,0x00,0x00,0x00,0x00,0x00,0x00,0x00,0x00,0x00,0x00,0x00,0x00,0x00,0x00,0x00,0x00,0x00,0x00,0x00,0x00,0x00,0x00,0x00,0x00,0x00,0x00,0x00,0x00,0x00},/*" ",0*/
  {0x00,0x00,0x00,0x00,0x00,0x00,0x00,0x00,0x60,0x00,0x60,0x00,0x60,0x00,0x60,0x00,0x60,0x00,0x60,0x00,0x60,0x00,0x40,0x00,0x20,0x00,0x20,0x00,0x20,0x00,0x00,0x00,0x00,0x00,0x00,0x00,0x60,0x00,0x60,0x00,0x60,0x00,0x00,0x00,0x00,0x00,0x00,0x00},/*"!",1*/
  {0x00,0x00,0x00,0x00,0x60,0x06,0x60,0x06,0x30,0x03,0x98,0x01,0x88,0x00,0x44,0x00,0x00,0x00,0x00,0x00,0x00,0x00,0x00,0x00,0x00,0x00,0x00,0x00,0x00,0x00,0x00,0x00,0x00,0x00,0x00,0x00,0x00,0x00,0x00,0x00,0x00,0x00,0x00,0x00,0x00,0x00,0x00,0x00},/*""",2*/
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  {0x00,0x00,0x1C,0x00,0x22,0x04,0xC2,0x04,0x80,0x03,0x00,0x00,0x00,0x00,0x00,0x00,0x00,0x00,0x00,0x00,0x00,0x00,0x00,0x00,0x00,0x00,0x00,0x00,0x00,0x00,0x00,0x00,0x00,0x00,0x00,0x00,0x00,0x00,0x00,0x00,0x00,0x00,0x00,0x00,0x00,0x00,0x00,0x00},/*"~",94*/
};

const uint8_t ASCII_3216[][64]={
  {0x00,0x00,0x00,0x00,0x00,0x00,0x00,0x00,0x00,0x00,0x00,0x00,0x00,0x00,0x00,0x00,0x00,0x00,0x00,0x00,0x00,0x00,0x00,0x00,0x00,0x00,0x00,0x00,0x00,0x00,0x00,0x00,0x00,0x00,0x00,0x00,0x00,0x00,0x00,0x00,0x00,0x00,0x00,0x00,0x00,0x00,0x00,0x00,0x00,0x00,0x00,0x00,0x00,0x00,0x00,0x00,0x00,0x00,0x00,0x00,0x00,0x00,0x00,0x00},/*" ",0*/
  {0x00,0x00,0x00,0x00,0x00,0x00,0x00,0x00,0x00,0x00,0xC0,0x01,0xC0,0x01,0xC0,0x01,0xC0,0x01,0xC0,0x01,0xC0,0x01,0xC0,0x01,0x80,0x00,0x80,0x00,0x80,0x00,0x80,0x00,0x80,0x00,0x80,0x00,0x80,0x00,0x00,0x00,0x00,0x00,0x00,0x00,0x00,0x00,0x80,0x01,0xC0,0x03,0xC0,0x03,0x80,0x01,0x00,0x00,0x00,0x00,0x00,0x00,0x00,0x00,0x00,0x00},/*"!",1*/
  {0x00,0x00,0x00,0x00,0x00,0x00,0xE0,0x1C,0xE0,0x1C,0xF0,0x1E,0x70,0x0E,0x38,0x07,0x18,0x03,0x08,0x01,0x84,0x00,0x00,0x00,0x00,0x00,0x00,0x00,0x00,0x00,0x00,0x00,0x00,0x00,0x00,0x00,0x00,0x00,0x00,0x00,0x00,0x00,0x00,0x00,0x00,0x00,0x00,0x00,0x00,0x00,0x00,0x00,0x00,0x00,0x00,0x00,0x00,0x00,0x00,0x00,0x00,0x00,0x00,0x00},/*""",2*/
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  {0x00,0x00,0x38,0x00,0xC4,0x00,0x86,0x40,0x02,0x61,0x00,0x22,0x00,0x1C,0x00,0x00,0x00,0x00,0x00,0x00,0x00,0x00,0x00,0x00,0x00,0x00,0x00,0x00,0x00,0x00,0x00,0x00,0x00,0x00,0x00,0x00,0x00,0x00,0x00,0x00,0x00,0x00,0x00,0x00,0x00,0x00,0x00,0x00,0x00,0x00,0x00,0x00,0x00,0x00,0x00,0x00,0x00,0x00,0x00,0x00,0x00,0x00,0x00,0x00},/*"~",94*/
};

void LCD_Set_PWM_Brightness(uint8_t brightness){
  
  TIM_OC_InitTypeDef sConfigOC = {0};
  GPIO_InitTypeDef GPIO_InitStruct = {0};
  
  HAL_TIM_PWM_Stop(&htim5,TIM_CHANNEL_1);
  HAL_TIMEx_PWMN_Stop(&htim5, TIM_CHANNEL_1);
  
  sConfigOC.OCMode = TIM_OCMODE_PWM1;
  sConfigOC.Pulse = brightness * 100;
  sConfigOC.OCPolarity = TIM_OCPOLARITY_HIGH;
  sConfigOC.OCFastMode = TIM_OCFAST_DISABLE;
  if (HAL_TIM_PWM_ConfigChannel(&htim5, &sConfigOC, TIM_CHANNEL_1) != HAL_OK)
  {
    Error_Handler();
  }
  
  GPIO_InitStruct.Pin = LCD_BL_Pin;
  GPIO_InitStruct.Mode = GPIO_MODE_AF_PP;
  GPIO_InitStruct.Pull = GPIO_NOPULL;
  GPIO_InitStruct.Speed = GPIO_SPEED_FREQ_VERY_HIGH;
  GPIO_InitStruct.Alternate = GPIO_AF2_TIM5;
  HAL_GPIO_Init(LCD_BL_GPIO_Port, &GPIO_InitStruct);
  
//  TIM5->CCR1 = brightness * 100;
  HAL_TIM_PWM_Start(&htim5,TIM_CHANNEL_1);
  HAL_TIMEx_PWMN_Start(&htim5, TIM_CHANNEL_1);
}

void LCD_Write_Data_8Bit(uint8_t data)
{
  HAL_SPI_Transmit(&hspi2,&data,1,HAL_SPI_TIMEOUT_DEFAULT_VALUE);
}

void LCD_Write_Data_16Bit(uint16_t data)
{
  uint8_t temp[2] = {0};
  temp[0] = data >> 8;
  temp[1] = data & 0xFF;
  HAL_SPI_Transmit(&hspi2,temp,2,HAL_SPI_TIMEOUT_DEFAULT_VALUE);
}

void LCD_Write_Reg(uint8_t data)
{
  LCD_DC_Clr();
  LCD_Write_Data_8Bit(data);
  LCD_DC_Set();
}

void LCD_Set_Address(uint16_t x_start,uint16_t y_start,uint16_t x_end,uint16_t y_end)
{
  LCD_Write_Reg(0x2a);
  LCD_Write_Data_16Bit(x_start);
  LCD_Write_Data_16Bit(x_end);
  LCD_Write_Reg(0x2b);
  LCD_Write_Data_16Bit(y_start);
  LCD_Write_Data_16Bit(y_end);
  LCD_Write_Reg(0x2c);
}

void LCD_Set_Rotation(void)
{
  LCD_Write_Reg(0x36); //MX, MY, RGB mode 
  if(Rotation==0){
    LCD_Write_Data_8Bit(0x00);
  }
  else if(Rotation==1){
    LCD_Write_Data_8Bit(0xC0);
  }
  else if(Rotation==2){
    LCD_Write_Data_8Bit(0x70);
  }
  else{
    LCD_Write_Data_8Bit(0xA0); 
  }
}

void LCD_Init(void)
{
  LCD_RES_Clr();
  delay_ms(10);
  LCD_RES_Set();
  delay_ms(10);
  
  LCD_Write_Reg(0x11);
  delay_ms(10);
  //------------------------------------ST7735S Frame Rate-----------------------------------------// 
  LCD_Write_Reg(0xB1); 
  LCD_Write_Data_8Bit(0x05); 
  LCD_Write_Data_8Bit(0x3C); 
  LCD_Write_Data_8Bit(0x3C); 
  LCD_Write_Reg(0xB2); 
  LCD_Write_Data_8Bit(0x05);
  LCD_Write_Data_8Bit(0x3C); 
  LCD_Write_Data_8Bit(0x3C); 
  LCD_Write_Reg(0xB3); 
  LCD_Write_Data_8Bit(0x05); 
  LCD_Write_Data_8Bit(0x3C); 
  LCD_Write_Data_8Bit(0x3C); 
  LCD_Write_Data_8Bit(0x05); 
  LCD_Write_Data_8Bit(0x3C); 
  LCD_Write_Data_8Bit(0x3C); 
  //------------------------------------End ST7735S Frame Rate---------------------------------// 
  LCD_Write_Reg(0xB4);
  LCD_Write_Data_8Bit(0x03); 
  //------------------------------------ST7735S Power Sequence---------------------------------// 
  LCD_Write_Reg(0xC0); 
  LCD_Write_Data_8Bit(0x28); 
  LCD_Write_Data_8Bit(0x08); 
  LCD_Write_Data_8Bit(0x04); 
  LCD_Write_Reg(0xC1); 
  LCD_Write_Data_8Bit(0XC0); 
  LCD_Write_Reg(0xC2); 
  LCD_Write_Data_8Bit(0x0D); 
  LCD_Write_Data_8Bit(0x00); 
  LCD_Write_Reg(0xC3); 
  LCD_Write_Data_8Bit(0x8D); 
  LCD_Write_Data_8Bit(0x2A); 
  LCD_Write_Reg(0xC4); 
  LCD_Write_Data_8Bit(0x8D); 
  LCD_Write_Data_8Bit(0xEE); 
  //---------------------------------End ST7735S Power Sequence-------------------------------------// 
  LCD_Write_Reg(0xC5); //VCOM 
  LCD_Write_Data_8Bit(0x1A); 
  LCD_Set_Rotation();
  //------------------------------------ST7735S Gamma Sequence---------------------------------// 
  LCD_Write_Reg(0xE0); 
  LCD_Write_Data_8Bit(0x04); 
  LCD_Write_Data_8Bit(0x22); 
  LCD_Write_Data_8Bit(0x07); 
  LCD_Write_Data_8Bit(0x0A); 
  LCD_Write_Data_8Bit(0x2E); 
  LCD_Write_Data_8Bit(0x30); 
  LCD_Write_Data_8Bit(0x25); 
  LCD_Write_Data_8Bit(0x2A); 
  LCD_Write_Data_8Bit(0x28); 
  LCD_Write_Data_8Bit(0x26); 
  LCD_Write_Data_8Bit(0x2E); 
  LCD_Write_Data_8Bit(0x3A); 
  LCD_Write_Data_8Bit(0x00); 
  LCD_Write_Data_8Bit(0x01); 
  LCD_Write_Data_8Bit(0x03); 
  LCD_Write_Data_8Bit(0x13); 
  LCD_Write_Reg(0xE1); 
  LCD_Write_Data_8Bit(0x04); 
  LCD_Write_Data_8Bit(0x16); 
  LCD_Write_Data_8Bit(0x06); 
  LCD_Write_Data_8Bit(0x0D); 
  LCD_Write_Data_8Bit(0x2D); 
  LCD_Write_Data_8Bit(0x26); 
  LCD_Write_Data_8Bit(0x23); 
  LCD_Write_Data_8Bit(0x27); 
  LCD_Write_Data_8Bit(0x27); 
  LCD_Write_Data_8Bit(0x25); 
  LCD_Write_Data_8Bit(0x2D); 
  LCD_Write_Data_8Bit(0x3B); 
  LCD_Write_Data_8Bit(0x00); 
  LCD_Write_Data_8Bit(0x01); 
  LCD_Write_Data_8Bit(0x04); 
  LCD_Write_Data_8Bit(0x13); 
  //------------------------------------End ST7735S Gamma Sequence-----------------------------// 
  LCD_Write_Reg(0x3A); //65k mode 
  LCD_Write_Data_8Bit(0x05); 
  LCD_Write_Reg(0x29); //Display on 

  LCD_Fill(0,0,LCD_W,LCD_H,BLACK);
  
//  LCD_BLK_Set();
//  delay_ms(10);
} 

void LCD_Fill(uint16_t x_start,uint16_t y_start,uint16_t x_end,uint16_t y_end,uint16_t color)
{          
  uint16_t i = 0,j = 0; 
  LCD_Set_Address(x_start,y_start,x_end-1,y_end-1);
  for(i=y_start;i<y_end;i++)
  {													   	 	
    for(j=x_start;j<x_end;j++)
    {
      LCD_Write_Data_16Bit(color);
    }
  }
}

void LCD_Draw_Point(uint16_t x,uint16_t y,uint16_t color)
{
  LCD_Set_Address(x,y,x,y);
  LCD_Write_Data_16Bit(color);
}

void LCD_Draw_Line(uint16_t x_start,uint16_t y_start,uint16_t x_end,uint16_t y_end,uint16_t color)
{
  uint16_t t = 0; 
  uint32_t xerr = 0,yerr = 0,delta_x = 0,delta_y = 0,distance = 0;
  uint32_t incx = 0,incy = 0,uRow = 0,uCol = 0;
  delta_x=x_end-x_start;
  delta_y=y_end-y_start;
  uRow=x_start;
  uCol=y_start;
  if(delta_x>0)incx=1;
  else if (delta_x==0)incx=0;
  else {incx=-1;delta_x=-delta_x;}
  if(delta_y>0)incy=1;
  else if (delta_y==0)incy=0; 
  else {incy=-1;delta_y=-delta_y;}
  if(delta_x>delta_y)distance=delta_x;
  else distance=delta_y;
  for(t=0;t<distance+1;t++)
  {
    LCD_Draw_Point(uRow,uCol,color);
    xerr+=delta_x;
    yerr+=delta_y;
    if(xerr>distance)
    {
      xerr-=distance;
      uRow+=incx;
    }
    if(yerr>distance)
    {
      yerr-=distance;
      uCol+=incy;
    }
  }
}

void LCD_Draw_Rectangle(uint16_t x_start, uint16_t y_start, uint16_t x_end, uint16_t y_end,uint16_t color)
{
  LCD_Draw_Line(x_start,y_start,x_end,y_start,color);
  LCD_Draw_Line(x_start,y_start,x_start,y_end,color);
  LCD_Draw_Line(x_start,y_end,x_end,y_end,color);
  LCD_Draw_Line(x_end,y_start,x_end,y_end,color);
}

void LCD_Draw_Circle(uint16_t x,uint16_t y,uint8_t r,uint16_t color)
{
  uint32_t a,b;
  a=0;b=r;	  
  while(a<=b)
  {
    LCD_Draw_Point(x-b,y-a,color);             //3           
    LCD_Draw_Point(x+b,y-a,color);             //0           
    LCD_Draw_Point(x-a,y+b,color);             //1                
    LCD_Draw_Point(x-a,y-b,color);             //2             
    LCD_Draw_Point(x+b,y+a,color);             //4               
    LCD_Draw_Point(x+a,y-b,color);             //5
    LCD_Draw_Point(x+a,y+b,color);             //6 
    LCD_Draw_Point(x-b,y+a,color);             //7
    a++;
    if((a*a+b*b)>(r*r))
    {
      b--;
    }
  }
}

void LCD_Show_Char(uint16_t x,uint16_t y,uint8_t num,uint16_t font_color,uint16_t background_color,uint8_t font_size,uint8_t mode)
{
  uint8_t temp = 0,sizex = 0,t = 0,m = 0;
  uint16_t i = 0,TypefaceNum = 0;
  uint16_t x0 = x;
  sizex=font_size/2;
  TypefaceNum=(sizex/8+((sizex%8)?1:0))*font_size;
  num=num-' ';
  LCD_Set_Address(x,y,x+sizex-1,y+font_size-1);
  for(i=0;i<TypefaceNum;i++)
  { 
    if(font_size==12)temp=ASCII_1206[num][i];
    else if(font_size==16)temp=ASCII_1608[num][i];
    else if(font_size==24)temp=ASCII_2412[num][i];
    else if(font_size==32)temp=ASCII_3216[num][i];
    else return;
    for(t=0;t<8;t++)
    {
      if(!mode)
      {
        if(temp&(0x01<<t))LCD_Write_Data_16Bit(font_color);
        else LCD_Write_Data_16Bit(background_color);
        m++;
        if(m%sizex==0)
        {
          m=0;
          break;
        }
      }
      else
      {
        if(temp&(0x01<<t))LCD_Draw_Point(x,y,font_color);
        x++;
        if((x-x0)==sizex)
        {
          x=x0;
          y++;
          break;
        }
      }
    }
  }   	 	  
}

void LCD_Show_String(uint16_t x,uint16_t y,const uint8_t *p,uint16_t font_color,uint16_t background_color,uint8_t font_size,uint8_t mode)
{         
  while(*p!='\0')
  {       
    LCD_Show_Char(x,y,*p,font_color,background_color,font_size,mode);
    x+=font_size/2;
    p++;
  }  
}

uint32_t mypow(uint8_t m,uint8_t n)
{
  uint32_t result=1;	 
  while(n--)result*=m;
  return result;
}

void LCD_Show_Int_Num(uint16_t x,uint16_t y,uint16_t num,uint8_t length,uint16_t font_color,uint16_t background_color,uint8_t font_size)
{         	
  uint8_t t = 0,temp = 0;
  uint8_t enshow = 0;
  uint8_t sizex=font_size/2;
  for(t=0;t<length;t++)
  {
    temp=(num/mypow(10,length-t-1))%10;
    if(enshow==0&&t<(length-1))
    {
      if(temp==0)
      {
        LCD_Show_Char(x+t*sizex,y,' ',font_color,background_color,font_size,0);
        continue;
      }else enshow=1; 
      
    }
    LCD_Show_Char(x+t*sizex,y,temp+48,font_color,background_color,font_size,0);
  }
} 

void LCD_Show_Float_Num(uint16_t x,uint16_t y,float num,uint8_t length,uint16_t font_color,uint16_t background_color,uint8_t font_size)
{         	
  uint8_t t = 0,temp = 0,sizex = 0;
  uint16_t num_temp = 0;
  sizex=font_size/2;
  num_temp=(uint16_t)(num*100);
  for(t=0;t<length;t++)
  {
    temp=(num_temp/mypow(10,length-t-1))%10;
    if(t==(length-2))
    {
      LCD_Show_Char(x+(length-2)*sizex,y,'.',font_color,background_color,font_size,0);
      t++;
      length+=1;
    }
    LCD_Show_Char(x+t*sizex,y,temp+48,font_color,background_color,font_size,0);
  }
}
